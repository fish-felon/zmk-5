/ {
    chosen {
        zmk,kscan = &kscan1;
    };

    kscan1: kscan {
        compatible = "zmk,kscan-gpio-direct";
        label = "GPIO Direct KSCAN Right";
        input-gpios = <
            &gpio0 2  GPIO_ACTIVE_LOW
            &gpio0 3  GPIO_ACTIVE_LOW
            &gpio0 4  GPIO_ACTIVE_LOW
            &gpio0 5  GPIO_ACTIVE_LOW
            &gpio0 6  GPIO_ACTIVE_LOW
            &gpio0 7  GPIO_ACTIVE_LOW
            &gpio0 8  GPIO_ACTIVE_LOW
            &gpio0 9  GPIO_ACTIVE_LOW
            &gpio0 10 GPIO_ACTIVE_LOW
            &gpio0 11 GPIO_ACTIVE_LOW
            &gpio0 12 GPIO_ACTIVE_LOW
        >;
        debounce-period-ms = <5>;
    };
};